## components/audio_source/Kconfig
```kconfig
menu "Audio Source"

    choice AUDIO_SOURCE_PRIMARY
        prompt "Primary audio input"
        default AUDIO_SOURCE_PRIMARY_I2S
        help
            Select the preferred audio input.  The firmware tries the primary
            source first.  If it is unavailable and a fallback is configured,
            it switches automatically.

        config AUDIO_SOURCE_PRIMARY_USB
            bool "USB Audio Class (UAC1) microphone"
            help
                Use a USB microphone as the primary input.  Requires USB Host
                to be enabled and a UAC1-compatible device to be attached.

        config AUDIO_SOURCE_PRIMARY_I2S
            bool "I2S via ES8311 codec (onboard)"
            help
                Use the onboard ES8311 codec connected to the ESP32-P4 I2S
                peripheral.  This is always available if the codec is wired.
    endchoice

    config AUDIO_SOURCE_SAMPLE_RATE
        int "Default sample rate (Hz)"
        default 48000
        help
            Audio capture sample rate.  Must be supported by the active
            source.  The ES8311 driver is reconfigured when this changes.
            Valid values: 8000, 16000, 44100, 48000, 96000.

    config AUDIO_SOURCE_BIT_DEPTH
        int "Bit depth"
        default 16
        range 16 32
        help
            ADC resolution in bits.  The ES8311 codec supports 16, 18, 20,
            and 24 bits.  All internal processing uses 16-bit signed integers.

    config AUDIO_SOURCE_I2S_MCLK_GPIO
        int "I2S master clock GPIO"
        default 13
        help
            GPIO connected to the ES8311 MCLK input.  On the ESP32-P4
            Function EV Board rev 1.5.2 this is GPIO 13.

    config AUDIO_SOURCE_I2S_BCLK_GPIO
        int "I2S bit clock GPIO"
        default 12
        help
            GPIO connected to the ES8311 BCLK (serial clock).  GPIO 12.

    config AUDIO_SOURCE_I2S_WS_GPIO
        int "I2S word select (LRCK) GPIO"
        default 10
        help
            GPIO connected to the ES8311 LRCK (left/right clock).  GPIO 10.

    config AUDIO_SOURCE_I2S_DOUT_GPIO
        int "I2S data out GPIO (ESP32→codec)"
        default 9
        help
            GPIO connected to the ES8311 SDIN (playback path, not used for
            recording but must be valid).  GPIO 9.

    config AUDIO_SOURCE_I2S_DIN_GPIO
        int "I2S data in GPIO (codec→ESP32)"
        default 11
        help
            GPIO connected to the ES8311 SDOUT (microphone capture data).
            GPIO 11.

    config AUDIO_SOURCE_ES8311_I2C_ADDR
        hex "ES8311 I2C address"
        default 0x18
        help
            7-bit I2C address of the ES8311 codec.  0x18 when the ADDR pin
            is tied to ground; 0x19 when tied to VDD.

    config AUDIO_SOURCE_READER_TASK_STACK
        int "Audio reader task stack size (bytes)"
        default 4096

    config AUDIO_SOURCE_READER_TASK_PRIORITY
        int "Audio reader task priority"
        default 22
        range 1 24
        help
            Priority for the I2S DMA reader task.  Must be high (≥20) to
            avoid missing DMA frames under load.  Same priority or higher
            than the DSP task.

    config AUDIO_SOURCE_READER_TASK_CORE
        int "Audio reader task CPU core"
        default 0
        range 0 1

    config AUDIO_SOURCE_DMA_BUF_FRAMES
        int "I2S DMA buffer size (frames per buffer)"
        default 256
        help
            Number of audio frames (samples) per I2S DMA buffer.
            Larger values reduce CPU overhead but increase latency.
            256 frames at 48 kHz = 5.3 ms.

    config AUDIO_SOURCE_DMA_BUF_COUNT
        int "Number of I2S DMA buffers"
        default 4
        range 2 8
        help
            Total DMA buffers allocated by the I2S driver.  The I2S peripheral
            ping-pongs between these.  4 buffers provide 21 ms of headroom.

endmenu
```

## components/dsp_engine/Kconfig
```kconfig
menu "DSP Engine"

    config DSP_ENGINE_DEFAULT_FFT_SIZE
        int "Default FFT size (power of two)"
        default 4096
        range 512 16384
        help
            Default FFT window length in samples. Must be a power of two.
            Larger sizes improve frequency resolution but increase latency
            and PSRAM usage.  4096 gives 11.6 Hz/bin at 48 kHz.

    config DSP_ENGINE_DEFAULT_SAMPLE_RATE
        int "Default sample rate (Hz)"
        default 48000
        help
            Audio sample rate used when the source has not yet negotiated
            a rate.  Must match the I2S or USB audio configuration.

    config DSP_ENGINE_TASK_STACK_SIZE
        int "DSP engine task stack size (bytes)"
        default 8192
        help
            Stack depth for the FreeRTOS DSP processing task.  The task
            uses floating-point math so it needs at least 6 KB.

    config DSP_ENGINE_TASK_PRIORITY
        int "DSP engine task priority"
        default 20
        range 1 24
        help
            FreeRTOS priority for the DSP task.  Should be below the audio
            capture task (22) but above the UI update task (7).

    config DSP_ENGINE_TASK_CORE
        int "DSP engine task CPU core"
        default 1
        range 0 1
        help
            CPU core affinity for the DSP task.  Core 1 is preferred to
            leave core 0 for the LVGL port task and UI updates.

    config DSP_ENGINE_RING_BUF_MULTIPLIER
        int "Ring buffer size multiplier (× FFT size)"
        default 4
        range 2 8
        help
            The ring buffer between the audio capture task and the DSP task
            is allocated as (multiplier × fft_size × sizeof(int16_t)) bytes.
            4× provides enough depth to absorb scheduling jitter at 48 kHz
            without stalling the USB or I2S DMA.

    config DSP_ENGINE_FRAME_POOL_SIZE
        int "Number of pre-allocated output frame slots"
        default 8
        range 4 16
        help
            The DSP engine maintains a fixed pool of output frames in PSRAM.
            Consumers retain frames via dsp_frame_retain(); the frame returns
            to the pool when all consumers release it.  Increase if consumers
            are slow (e.g. HTTP chunked transfer) to avoid dropped frames.

endmenu
```

## sdkconfig.defaults
```kconfig
# ESP32-P4 Function EV Board V1.5.2 - Default Configuration
#
# Chip revision: ECO2 (pre-rev3 silicon)
# Rev <3.0 and >=3.0 are mutually exclusive in ESP-IDF — must select this first
CONFIG_ESP32P4_SELECTS_REV_LESS_V3=y
CONFIG_ESP32P4_REV_MIN_1=y
CONFIG_ESP32P4_REV_MIN_FULL=1
CONFIG_ESP_REV_MIN_FULL=1

# PSRAM — P4 Function EV Board uses HEX-8 mode (NOT OCT).
# The generated sdkconfig confirms CONFIG_SPIRAM_MODE_HEX=y; using OCT
# causes PSRAM init to fail and all PSRAM allocations to crash.
CONFIG_SPIRAM=y
CONFIG_SPIRAM_MODE_HEX=y
CONFIG_SPIRAM_SPEED_200M=y
# Keep small allocs (≤32 KB) in internal SRAM; push large FFT tables to PSRAM
CONFIG_SPIRAM_MALLOC_ALWAYSINTERNAL=32768

# Flash — 16 MB on this board
CONFIG_ESPTOOLPY_FLASHSIZE_16MB=y

# Custom partition table: adds OTA slots + SPIFFS for web assets and cal files
CONFIG_PARTITION_TABLE_CUSTOM=y
CONFIG_PARTITION_TABLE_CUSTOM_FILENAME="partitions.csv"

# FreeRTOS — 1 kHz tick for accurate audio timing (pdMS_TO_TICKS precision)
CONFIG_FREERTOS_HZ=1000

# Stack overflow detection
CONFIG_FREERTOS_CHECK_STACKOVERFLOW_CANARY=y

# Allow FreeRTOS task stacks in PSRAM for DSP/audio tasks
CONFIG_SPIRAM_ALLOW_STACK_EXTERNAL_MEMORY=y

# Increase main task stack — app_main orchestrates heavy component init
CONFIG_ESP_MAIN_TASK_STACK_SIZE=8192

# System event queue — needs more headroom with WiFi + USB + audio events
CONFIG_SYSTEM_EVENT_QUEUE_SIZE=64

# Watchdog — increase timeout; 16384-pt FFT twiddle table init can take >5 s
# on first boot (coefficient table generation + PSRAM write)
CONFIG_ESP_TASK_WDT_TIMEOUT_S=30

# USB Host — bias hardware scheduler toward isochronous IN (microphone)
CONFIG_USB_HOST_HW_BUFFER_BIAS_IN=y
CONFIG_USB_HOST_CONTROL_TRANSFER_MAX_SIZE=512

# I2S — place ISR handler in IRAM to meet strict DMA timing
CONFIG_I2S_ISR_IRAM_SAFE=y

# HTTP server — WebSocket support for browser-based spectrum viewer
CONFIG_HTTPD_WS_SUPPORT=y
CONFIG_HTTPD_MAX_REQ_HDR_LEN=2048

# LWIP tuning for WebSocket connections (4 clients × 32 KB window)
CONFIG_LWIP_MAX_SOCKETS=16
CONFIG_TCP_WND_DEFAULT=32768
CONFIG_TCP_SND_BUF_DEFAULT=32768

# mDNS — allow up to 5 service advertisements (HTTP, WebSocket, ...)
CONFIG_MDNS_MAX_SERVICES=5

# NVS — strict error checking for configuration storage
CONFIG_NVS_ASSERT_ERROR_CHECK=y

# SD card — format to FAT32 automatically if mount fails (handles unformatted / exFAT / NTFS cards)
CONFIG_BSP_SD_FORMAT_ON_MOUNT_FAIL=y

# OTA — require HTTPS for firmware updates
CONFIG_OTA_ALLOW_HTTP=n
CONFIG_MBEDTLS_CERTIFICATE_BUNDLE=y

# LVGL fonts used by the spectrum analyzer UI
CONFIG_LV_FONT_MONTSERRAT_12=y
CONFIG_LV_FONT_MONTSERRAT_14=y
CONFIG_LV_FONT_MONTSERRAT_16=y
CONFIG_LV_FONT_MONTSERRAT_24=y
CONFIG_LV_FONT_MONTSERRAT_48=y

# FAT long filename support for named settings presets on SD
CONFIG_FATFS_LFN_HEAP=y
CONFIG_FATFS_MAX_LFN=64
```
